## conf/machine/include/qcom-kaanapali.inc
```bitbake
# Configurations and variables for SM8850 SoC family.

SOC_FAMILY = "sm8850"
require conf/machine/include/qcom-base.inc
require conf/machine/include/qcom-common.inc

#QCOM_VFAT_SECTOR_SIZE = "512"
#require conf/machine/include/arm/armv8a/tune-cortexa53.inc

DEFAULTTUNE = "armv8-2a-crypto"
require conf/machine/include/arm/arch-armv8-2a.inc

MACHINE_ESSENTIAL_EXTRA_RRECOMMENDS += " \
    packagegroup-qcom-boot-essential \
"

MACHINE_EXTRA_RRECOMMENDS += " \
    packagegroup-qcom-boot-additional \
"
```

## conf/machine/include/qcom-shikra.inc
```bitbake
# Configurations and variables for Shikra SoC family.

SOC_FAMILY = "shikra"
require conf/machine/include/qcom-base.inc
require conf/machine/include/qcom-common.inc

PREFERRED_PROVIDER_virtual/kernel = "shikra-qcom-linux-next"

require conf/machine/include/arm/arch-armv8-1a.inc

MACHINE_ESSENTIAL_EXTRA_RRECOMMENDS += " \
    packagegroup-qcom-boot-essential \
"

MACHINE_EXTRA_RRECOMMENDS += " \
    packagegroup-qcom-boot-additional \
"
```

## conf/machine/kaanapali-mtp.conf
```bitbake
#@TYPE: Machine
#@NAME: Qualcomm Kaanapali Development Kit
#@DESCRIPTION: Machine configuration for Qualcomm Kaanapali development Kit

require conf/machine/include/qcom-kaanapali.inc

MACHINE_FEATURES = "efi usbhost usbgadget alsa wifi bluetooth"

QCOM_DTB_DEFAULT ?= "kaanapali-mtp"

KERNEL_DEVICETREE ?= " \
                      qcom/kaanapali-mtp.dtb \
                      "

QCOM_BOOT_FILES_SUBDIR = "sm8850"
QCOM_PARTITION_FILES_SUBDIR = "partitions/kaanapali-mtp"
```

## conf/machine/shikra.conf
```bitbake
#@TYPE: Machine
#@NAME: Qualcomm Shikra Beta Evaluation Kit (EVK)
#@DESCRIPTION: Machine configuration for Qualcomm Shikra Evaluation Kit (EVK)

require conf/machine/include/qcom-shikra.inc

MACHINE_FEATURES += "efi pci"

KERNEL_DEVICETREE ?= " \
                      qcom/shikra-cqm-evk.dtb \
                      qcom/shikra-cqs-evk.dtb \
                      qcom/shikra-iqs-evk.dtb \
                      "

MACHINE_ESSENTIAL_EXTRA_RRECOMMENDS += " \
"

QCOM_CDT_FILE = ""
QCOM_BOOT_FILES_SUBDIR = "shikra"
QCOM_PARTITION_FILES_SUBDIR ?= "partitions/shikra/emmc"

QCOM_BOOT_FIRMWARE = ""
```

## conf/machine/sm8750-mtp.conf
```bitbake
#@TYPE: Machine
#@NAME: Qualcomm SM8750 Development Kit
#@DESCRIPTION: Machine configuration for Qualcomm SM8750 development Kit

require conf/machine/include/qcom-sm8750.inc

MACHINE_FEATURES = "efi usbhost usbgadget alsa wifi bluetooth"

QCOM_BOOTIMG_ROOTFS = "PARTLABEL=system"

QCOM_DTB_DEFAULT ?= "sm8750-mtp"

KERNEL_DEVICETREE ?= " \
                      qcom/sm8750-mtp.dtb \
                      "

QCOM_BOOT_FILES_SUBDIR = "sm8750"
QCOM_PARTITION_FILES_SUBDIR = "partitions/sm8750-mtp"
```
